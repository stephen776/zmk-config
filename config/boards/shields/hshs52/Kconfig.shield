## config/boards/shields/hshs52/Kconfig.shield
```kconfig
# Copyright (c) 2021-2022 The ZMK Contributors
# SPDX-License-Identifier: MIT

config SHIELD_HSHS52_LEFT
    def_bool $(shields_list_contains,hshs52_left)

config SHIELD_HSHS52_RIGHT
    def_bool $(shields_list_contains,hshs52_right)

config SHIELD_HSHS52_DONGLE
    def_bool $(shields_list_contains,hshs52_dongle)
```
