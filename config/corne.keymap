/*
 * copyright (c) 2020 the zmk contributors
 *
 * spdx-license-identifier: mit
 */


/* source keypos helpers*/
#include "../keypos_def/keypos_36keys.h"

#define THREE_THUMBS

/* source the main keymap */
#include "base.keymap"

/ { chosen { zmk,matrix_transform = &five_column_transform; }; };
